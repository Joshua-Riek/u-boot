// SPDX-License-Identifier: (GPL-2.0+ OR MIT)

/dts-v1/;

#include "rk3588s-orangepi-5.dts"

/ {
	model = "Orange Pi 5B";
	compatible = "xunlong,orangepi-5", "rockchip,rk3588s";
};

&sdhci {
	status = "okay";
};
