// SPDX-License-Identifier: (GPL-2.0+ OR MIT)
/*
 * Copyright (c) 2023 Radxa Limited
 */

#include "rk356x-u-boot.dtsi"

/ {
	chosen {
		stdout-path = &uart2;
	};
};

&uart2 {
	clock-frequency = <24000000>;
	u-boot,dm-pre-reloc;
	status = "okay";
};

&usb_host0_xhci {
	status = "okay";
};