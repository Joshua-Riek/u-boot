## board/orangepi/orangepi5-rk3588s/Kconfig
```kconfig
if TARGET_ORANGEPI5_RK3588

config SYS_BOARD
	default "orangepi5-rk3588s"

config SYS_VENDOR
	default "orangepi"

config SYS_CONFIG_NAME
	default "orangepi5-rk3588s"

config BOARD_SPECIFIC_OPTIONS # dummy
	def_bool y

endif
```

## board/orangepi/orangepi5b-rk3588s/Kconfig
```kconfig
if TARGET_ORANGEPI5B_RK3588

config SYS_BOARD
	default "orangepi5b-rk3588s"

config SYS_VENDOR
	default "orangepi"

config SYS_CONFIG_NAME
	default "orangepi5b-rk3588s"

config BOARD_SPECIFIC_OPTIONS # dummy
	def_bool y

endif
```
